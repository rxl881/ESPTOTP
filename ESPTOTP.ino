#include <FS.h>
#include <EEPROM.h>
#include <ArduinoJson.h>
#include <OLEDDisplay.h>
#include <SSD1306.h>
#include <NTPClient.h>
#include <ezTime.h>
#include <ESP8266WiFi.h>
#include <DNSServer.h>
#include <ESP8266WebServer.h>
#include <WiFiManager.h>
#include <ESP8266Ping.h>
#include "TotpUtils.h"
#include "TimerDisplay.h"
#include "HeartBeat.h"

// connect to display using pins D1, D2 for I2C on address 0x3c
SSD1306  display(0x3c, D1, D2);

// Wifi connection creds
const char *location = "Europe/London";
const char *timeServer = "uk.pool.ntp.org";
const char *apName = "ESPTOTP";
const char *apPass = "esptotp99";
const char *versionString = "ESPTOTP v0.2 - MH";
const char *serialNumber = "002";

// Display config
const int displayWidth = 128;
const int displayHeight = 64;

// Message display timeouts
const int bootScreenDelay = 5000;
const int shortDelay = 200;
const int longDelay = 500;
const int buttonDebouncePeriod = 1000;

// LED DEFINITIONS
#define BLUE_LED LED_BUILTIN
#define GREEN_LED 16

// Matrix logo (XBM) data
#define matrix_logo_width 128
#define matrix_logo_height 55
static uint8_t matrix_logo_bits[] PROGMEM = {
  0x3f, 0x00, 0x00, 0x00, 0x00, 0x00, 0x00, 0x00, 0x00, 0x00, 0x00, 0x00,
  0x00, 0x00, 0x00, 0xfc, 0x3f, 0x00, 0x00, 0x00, 0x00, 0x00, 0x00, 0x00,
  0x00, 0x00, 0x00, 0x00, 0x00, 0x00, 0x00, 0xfc, 0x03, 0x00, 0x00, 0x00,
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  0x00, 0x00, 0x00, 0xfc
};

//  WiFi icon.
#define wifi_icon_width 32
#define wifi_icon_height 32
static uint8_t wifi_icon_bits[] PROGMEM = {
  0x00, 0x00, 0x00, 0x00, 0x00, 0x00, 0x00, 0x00, 0x00, 0x00, 0x00, 0x00,
  0x00, 0x80, 0x01, 0x00, 0x00, 0xFC, 0x3F, 0x00, 0x80, 0xFF, 0xFF, 0x01,
  0xE0, 0xFF, 0xFF, 0x07, 0xF0, 0xBF, 0xFD, 0x0F, 0xFC, 0x03, 0xC0, 0x3F,
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  0x00, 0x00, 0x00, 0x00, 0x00, 0x00, 0x00, 0x00
};

// Clock icon
#define clock_icon_width 32
#define clock_icon_height 32
static uint8_t clock_icon_bits[] PROGMEM = {
  0x00, 0xF8, 0x1F, 0x00, 0x00, 0xFE, 0x7F, 0x00, 0x80, 0x0F, 0xF8, 0x01,
  0xC0, 0x03, 0xC0, 0x03, 0xE0, 0x00, 0x00, 0x07, 0x70, 0x00, 0x00, 0x0E,
  0x38, 0x80, 0x01, 0x1C, 0x1C, 0x80, 0x01, 0x38, 0x0C, 0x80, 0x01, 0x30,
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  0x00, 0xFE, 0x7F, 0x00, 0x00, 0xF8, 0x0F, 0x00
};

// Checkmark icon
#define check_icon_width 32
#define check_icon_height 32
static uint8_t check_icon_bits[] PROGMEM = {
  0x00, 0x60, 0x03, 0x00, 0x00, 0xF8, 0x3F, 0x00, 0x00, 0xFF, 0xFF, 0x00,
  0x80, 0x7F, 0xFF, 0x01, 0xE0, 0x07, 0xE0, 0x03, 0xE0, 0x01, 0x80, 0x0F,
  0xF0, 0x00, 0x00, 0x0F, 0x78, 0x00, 0x00, 0x1E, 0x3C, 0x00, 0x00, 0x3C,
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  0x00, 0xFC, 0x1F, 0x00, 0x00, 0x80, 0x05, 0x00
};

// Cross icon
#define cross_icon_width 32
#define cross_icon_height 32
static uint8_t cross_icon_bits[] PROGMEM = {
  0x00, 0x60, 0x03, 0x00, 0x00, 0xF8, 0x3F, 0x00, 0x00, 0xFF, 0xFF, 0x00,
  0x80, 0x7F, 0xFE, 0x01, 0xE0, 0x07, 0xE0, 0x03, 0xE0, 0x01, 0x80, 0x0F,
  0xF0, 0x00, 0x00, 0x0F, 0x78, 0x00, 0x00, 0x1E, 0x3C, 0x00, 0x00, 0x3C,
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  0x00, 0xFC, 0x1F, 0x00, 0x00, 0x40, 0x03, 0x00
};

String msg;                             // General purpose message display / output
long lastButtonPress = 0;               // Time of last button press (used for debounce)
volatile unsigned int displayScreen = 1;// Interrupt flag - Should display be on / updated
                                        // 0 (00) = Screen off
                                        // 1 (01) = Normal operation
                                        // 2 (10) = Screensaver
                                        // 3 (11) = Config
volatile bool displayCleared = false;   // Has the display been cleared (following interrupt)
unsigned long codeUpdate = 0;           // Time of last TOTP code update
uint code = 0;                          // Current TOTP code
uint oldCode = 0;                       // Old TOTP code
char totpSecretString[40];
WiFiManagerParameter totpSecret("totpSecret", "TOTP Secret (Base32 encoded e.g. 'AZFR23QND4B6S2MDDO7DL7X7WU')", totpSecretString, 32);
TotpUtils *totp;
TimerDisplay *timerDisplay;
Timezone Location;

// Display icon
void displayIcon(uint iconWidth, uint iconHeight, uint8_t* iconBits, bool flushDisplay, int x, int y) {
  if (x < 0 || y < 0) {
    x = (displayWidth / 2) - (iconWidth / 2);
    y = (displayHeight - iconHeight);
  }

  display.drawXbm(x, y, iconWidth, iconHeight, iconBits);
  if (flushDisplay) {
    display.display();
  }
}

// Display wifi icon
void displayWifiIcon(bool flushDisplay, int x, int y) {
  displayIcon(wifi_icon_width, wifi_icon_height, wifi_icon_bits, flushDisplay, x, y);
}

// Display clock icon
void displayClockIcon(bool flushDisplay, int x, int y) {
  displayIcon(clock_icon_width, clock_icon_height, clock_icon_bits, flushDisplay, x, y);
}

// Display check icon
void displayCheckIcon(bool flushDisplay, int x, int y) {
  displayIcon(check_icon_width, check_icon_height, check_icon_bits, flushDisplay, x, y);
}

// Display cross icon
void displayCrossIcon(bool flushDisplay, int x, int y) {
  displayIcon(cross_icon_width, cross_icon_height, cross_icon_bits, flushDisplay, x, y);
}

// WiFiManager callbacks
// Update display when starting WiFi connection
void startWifiConnection() {
  display.setTextAlignment(TEXT_ALIGN_LEFT);
  display.setFont(ArialMT_Plain_10);
  msg = String("Connecting to wifi...");
  display.clear();
  display.drawStringMaxWidth(0, 0, displayWidth, msg);
  displayWifiIcon(false, -1, -1);
  display.display();

  HeartBeat heartbeat(&display, 0, 50, 100);
}

// Update display when WiFi connected
void wifiConnected() {
  display.setTextAlignment(TEXT_ALIGN_LEFT);
  display.setFont(ArialMT_Plain_10);
  msg = String("Connected to wifi...");
  Serial.println("\n" + msg);
  Serial.print("TOTP Secret: ");
  Serial.println(totpSecret.getValue());
  display.clear();
  display.drawStringMaxWidth(0, 0, displayWidth, msg);
  displayCheckIcon(false, -1, -1);
  display.display();
  delay(500);
}

// Entering config
void enteringWifiConfig(WiFiManager *myWiFiManager) {
  display.setTextAlignment(TEXT_ALIGN_LEFT);
  display.setFont(ArialMT_Plain_16);
  msg = String("WIFI Config");
  Serial.println("\n" + msg);
  display.clear();
  display.drawStringMaxWidth(0, 0, displayWidth, msg);
  display.setFont(ArialMT_Plain_10);
  display.drawStringMaxWidth(0, 18, displayWidth, "Connect to " + String(myWiFiManager->getConfigPortalSSID()) + " access point to manage config.");
  displayWifiIcon(false, displayWidth - 32, 0);
  display.display();
}

// Save settings (Called when connection has been established)
void saveConfigCallback() {
  display.setTextAlignment(TEXT_ALIGN_LEFT);
  display.setFont(ArialMT_Plain_10);
  msg = String("Settings saved and wifi connection established! :)");
  Serial.println("\n" + msg);
  Serial.print("TOTP Secret: ");
  Serial.println(totpSecret.getValue());
  
  Serial.println("Saving config to FS");
  DynamicJsonDocument json(1024);
  String secret = totpSecret.getValue();
  secret.trim();
  secret.toUpperCase();
  json["totp_secret"] = secret;
    File configFile = SPIFFS.open("/config.json", "w");
  if (!configFile) {
    Serial.println("failed to open config file for writing");
  }
  serializeJson(json, configFile);
  configFile.close();

  display.clear();
  display.drawStringMaxWidth(0, 0, displayWidth, msg);
  displayCheckIcon(false, -1, -1);
  display.display();

  delay(1000);
  ESP.restart();
  delay(5000);
}

// Display Matrix logo and board info
void displayScreensaver() {
  display.clear();
  display.drawXbm(0, 0, matrix_logo_width, matrix_logo_height, matrix_logo_bits);
  display.setFont(ArialMT_Plain_10);
  display.drawStringMaxWidth(4, displayHeight - 10, displayWidth, String(versionString) + String(" (") + String(serialNumber) + String(")"));
  display.display();
}

// Display boot screen logo and info.
void displayBootScreen() {
  displayScreensaver();
}

void formatFS() {
  Serial.print("Formatting FS... ");
  SPIFFS.format();
  Serial.println("Done!");
}

// Toggle screen on / off
void ICACHE_RAM_ATTR toggleScreen() {
  long now = millis();
  displayCleared = false;
  if (now - lastButtonPress > buttonDebouncePeriod) {
    lastButtonPress = now;
    displayScreen++;
    if (displayScreen >= 3) {
      displayScreen = 0;
      Serial.println("Turning screen off");
    } else if (displayScreen == 1) {
      Serial.println("Turning screen on");
    } else if (displayScreen == 2) {
      Serial.println("Displaying screensaver");
    } else {
      Serial.print("Invalid screen mode:");
      Serial.print(displayScreen);
      // Set screen to on / normal mode
      displayScreen = 1;
    }
  }
}

// Interrupt handler for button press triggering wifi setup portal
void ICACHE_RAM_ATTR handleEnterWifiConfig() {
  digitalWrite(GREEN_LED, LOW);
  displayCleared = false;
  displayScreen = 3;
}

void clearEEPROM() {
  int i;
  for (i=0; i<512; i++) {
    EEPROM.write(i, 0);
  }
  EEPROM.commit();
}

void readEEPROMPattern() {
  int i;
  for (i=0; i<512; i++) {
    byte j = EEPROM.read(i);
    Serial.print(j);
    Serial.print(", ");
  }
  Serial.println("");
}

// Program setup
void setup() {
  EEPROM.begin(512);

  // Serial and debug setup
  Serial.begin(115200);
  setDebug(DEBUG);

  delay(1000);
  readEEPROMPattern();
  byte reset = EEPROM.read(0);
  if (reset > 1) {
    Serial.println(String("Clearing EEPROM: ") + String(reset));
    clearEEPROM();
    Serial.println("DONE");
  }
  delay(1000);
  readEEPROMPattern();

  WiFiManager wifiManager;
  wifiManager.addParameter(&totpSecret);

  // Initialise EEPROM
  reset = EEPROM.read(0);

  if (reset == 1) {
    Serial.println("Config reset requested. Resetting now");
    wifiManager.resetSettings();
    EEPROM.write(0, 0);
    EEPROM.commit();
    Serial.println("WiFi settings and TOTP config reset!");
  } else if (reset > 1) {
    Serial.println(String("Invalid EEPROM state: ") + String(reset));
    EEPROM.write(0, 0);
    EEPROM.commit();
  } else {
    Serial.println(String("EEPROM schema valid: ") + String(reset));
  }
  EEPROM.end();

  // Set up button inputs
  // pinMode(D3, INPUT_PULLUP); // LEFT
  // pinMode(D4, INPUT_PULLUP); // RIGHT     -- Reset board
  // pinMode(D5, INPUT_PULLUP); // PUSH DOWN
  pinMode(D6, INPUT_PULLUP);    // UP        -- Reset config and restart
  pinMode(D7, INPUT_PULLUP);    // DOWN      -- Rotate display screens

  // Attach button interrupt handlers
  // attachInterrupt(digitalPinToInterrupt(D3), handleEnterWifiConfig, FALLING);
  // attachInterrupt(digitalPinToInterrupt(D5), handleEnterWifiConfig, FALLING);
  attachInterrupt(digitalPinToInterrupt(D6), handleEnterWifiConfig, FALLING);
  attachInterrupt(digitalPinToInterrupt(D7), toggleScreen, FALLING);

  // Configure LEDs
  // Configure Main (Blue) LED
  pinMode(BLUE_LED, OUTPUT);
  // Configure Main (Blue) LED
  pinMode(GREEN_LED, OUTPUT);
  // Turn the Green LED off
  pinMode(D0, OUTPUT);
  digitalWrite(GREEN_LED, HIGH);

  // Init the display
  display.init();
  display.flipScreenVertically();
  display.setTextAlignment(TEXT_ALIGN_LEFT);
  display.setFont(ArialMT_Plain_10);

  // Show the Matrix startup logo
  displayBootScreen();
  delay(bootScreenDelay);

  // Init the timer animation
  timerDisplay = new TimerDisplay(&display, displayWidth, displayHeight);

  // Start FS
  SPIFFS.begin();
  const char* defaultSecret = "ssssssssssssssssssssssssss";
  if (SPIFFS.exists("/config.json")) {
    File configFile = SPIFFS.open("/config.json", "r");
    if (configFile) {
      size_t size = configFile.size();
      // Allocate a buffer to store contents of the file.
      std::unique_ptr<char[]> buf(new char[size]);
      configFile.readBytes(buf.get(), size);
      DynamicJsonDocument json(1024);
      auto deserializeError = deserializeJson(json, buf.get());
      serializeJson(json, Serial);
      if ( ! deserializeError ) {
          String output;
          serializeJsonPretty(json, output);
          if (strlen(json["totp_secret"]) > 0) {
            strcpy(totpSecretString, json["totp_secret"]);
          } else {
            strcpy(totpSecretString, defaultSecret);
          }
      }
    }
  } else {
    Serial.println("Config not present");
    strcpy(totpSecretString, defaultSecret);
  }

  // Intialise TOTP code generation
  totp = new TotpUtils(totpSecretString);

  // Init WiFi
  startWifiConnection();
  wifiManager.setTimeout(120);
  wifiManager.setAPCallback(enteringWifiConfig);
  wifiManager.setSaveConfigCallback(saveConfigCallback);
  if (!wifiManager.autoConnect(apName, apPass)) {
    msg = "Failed to connect to access point. Resetting";
    Serial.println(msg);
    display.clear();
    display.drawStringMaxWidth(0, 0, displayWidth, msg);
    displayCrossIcon(false, -1, -1);
    display.display();
    delay(1000);
    ESP.reset();
    delay(5000);
  }
  wifiConnected();

  // Time setup
  setServer(timeServer);
  // Adding ping to try and troubleshoot NTP timeout
  Serial.println("Pinging timeserver: " + String(timeServer));
  byte serverUp = false;
  while (serverUp != true) {
    Serial.print(".");
    serverUp = Ping.ping(timeServer);
  }
  Serial.println("\nTimeserver is reachable and responded in " + String(Ping.averageTime()) + "ms");

  msg = "Waiting for time to sync.";
  Serial.println(msg);
  display.clear();
  displayClockIcon(false, -1, -1);
  display.drawString(0, 0, msg);

  display.display();

  // Wait for time client to synchronise
  waitForSync(5000);

  msg = "Initialisation complete";
  display.clear();
  display.drawString(0, 0, msg);
  displayCheckIcon(false, -1, -1);
  display.display();
  delay(longDelay);

  if (!Location.setCache(0)) Location.setLocation(location);
}

// Reset saved wifi config and reset
// This should trigger the wifi config portal on next startup
void resetAndWifiConfig() {
  msg = "Resetting config";
  Serial.println(msg);
  display.setFont(ArialMT_Plain_10);
  display.clear();
  display.drawStringMaxWidth(0, 0, displayWidth, msg);
  displayCrossIcon(false, -1, -1);
  display.display();
  displayCleared = true;

  // Format FS
  formatFS();

  EEPROM.begin(512);
  EEPROM.write(0, 1); // Request config reset on next boot
  EEPROM.commit();
  delay(1000);

  byte reset = EEPROM.read(0);
  Serial.print(String("RESET FLAG: "));
  Serial.print(String(reset));
  EEPROM.end();
  ESP.restart();
  delay(5000);
}

// Main program loop
void loop() {
  if (displayScreen == 1) {
    displayCleared = false;
    digitalWrite(LED_BUILTIN, HIGH);

    String timeString = Location.dateTime();
    int commaIndex = timeString.indexOf(",");
    if (commaIndex > 0) {
      timeString.remove(3, commaIndex - 3);
    }

    display.clear();
    display.setTextAlignment(TEXT_ALIGN_LEFT);

    // Display the time
    display.setFont(ArialMT_Plain_10);
    display.drawString(0, 0, String(location) + ":");
    display.drawStringMaxWidth(0, 10, displayWidth, timeString);

    // Get the TOTP code
    unsigned long ts = UTC.now();
    oldCode = code;
    code = totp->getCode(ts);
    if (oldCode != code) {
      codeUpdate = ts;
    }

    // Format the code for display
    char paddedCode[7] = {'\0'};
    sprintf(paddedCode, "%06d", code);
    String formattedCode = String(paddedCode);
    formattedCode = formattedCode.substring(0, 3) + "-" + formattedCode.substring(3, 6);
    Serial.println("Code: " + formattedCode + "\n");

    // Display the TOTP code
    display.setFont(ArialMT_Plain_24);
    display.drawString(0, displayHeight - 24, formattedCode);

    timerDisplay->update(codeUpdate, ts);
    display.display();

    delay(longDelay);
    digitalWrite(LED_BUILTIN, LOW);
    delay(longDelay);
  } else if (displayScreen == 2 && displayCleared == false) {
    displayScreensaver();
    displayCleared = true;
  } else if (displayScreen == 3) {
    if (displayCleared == false) {
      resetAndWifiConfig();
    }
  } else {
    if (displayCleared == false) {
      display.clear();
      display.display();
      displayCleared = true;
    }
  }
}
